## app_ws/w_mic_v1.0/build/Kconfig/Kconfig.shield
```kconfig
osource "D:/Andrea/Embedded/repositories/w_microphone/app_ws/w_mic_v1.0/boards/shields/*/Kconfig.shield"
osource "C:/ncs/v3.0.1/nrf/boards/shields/*/Kconfig.shield"
```

## app_ws/w_mic_v1.0/build/Kconfig/boards/Kconfig.nrf5340dk
```kconfig
# Load board Kconfig descriptions.
osource "C:/ncs/v3.0.1/zephyr/boards/nordic/nrf5340dk/Kconfig.nrf5340dk"
```

## app_ws/w_mic_v1.0/build/w_mic_v1.0/Kconfig/Kconfig.shield.defconfig
```kconfig
osource "D:/Andrea/Embedded/repositories/w_microphone/app_ws/w_mic_v1.0/boards/shields/*/Kconfig.defconfig"
osource "C:/ncs/v3.0.1/nrf/boards/shields/*/Kconfig.defconfig"
```
